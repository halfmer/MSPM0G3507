#include "LED.h"
#include "Key.h"
#include "OLED.h"
#include "delay.h"
#include "ti_msp_dl_config.h"

/*==================================================================================*/
//DAC输出引脚设置为PA15
/*==================================================================================*/
//matlab输出正弦波采样点函数参考,可以让ai仿写并修改输出参数:
/*
    % DAC输出范围（12位DAC）
    DAC_range = 2^12; % 4096个离散级别
     
    % 生成正弦波形数组
    num_samples = 256;
    t = linspace(0, 2*pi, num_samples); % 时间从0到2*pi，等分成512份
    sin_wave = sin(t);
     
    % 将正弦波形归一化到DAC输出范围（0到4095）
    normalized_sin_wave = (sin_wave + 1) * (DAC_range - 1) / 2;
     
    % 将归一化的数组四舍五入为整数
    dac_output_values = round(normalized_sin_wave);
     
    % 绘制DAC输出波形
    figure;
    plot(dac_output_values);
    title('DAC输出正弦波形');
    xlabel('样本');
    ylabel('DAC输出值');
    grid on;
     
    % 将数组保存到文件中
    writematrix(dac_output_values, 'dac_output_values.txt');
    disp('DAC输出值已保存到文件：dac_output_values.txt');
 */
/*==================================================================================*/

#define DAC12_REF_VOLTAGE_mV    (3300)

static uint8_t key;
static uint8_t gCounter;
static uint8_t Mode = 0,temp;

//正弦波数据表
const uint16_t Sine_wave[]={2048,2098,2148,2199,2249,2299,2349,2399,2448,2498,2547,2596,2644,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2047
};
//三角波数据表
const uint16_t triangle_wave[]={0,32,64,96,128,161,193,225,257,289,321,353,385,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0
};
//方波数据表
const uint16_t square_wave[]={4095,4095,4095,4095,4095,4095,4095,4095,4095,4095,4095,4095,4095,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4095
};
//上升沿锯齿波数据表
const uint16_t Sawtooth_Wave[]={2048,2064,2080,2096,2112,2128,2144,2160,2176,2192,2208,2224,2240,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2048
};


//设置生成的波形
//正弦波
#define OUTPUT_SIGNAL0       Sine_wave
#define OUTPUT_SIGNAL_SIZE0  (sizeof(OUTPUT_SIGNAL0)/sizeof(uint16_t))

//三角波
#define OUTPUT_SIGNAL1       triangle_wave
#define OUTPUT_SIGNAL_SIZE1  (sizeof(OUTPUT_SIGNAL1)/sizeof(uint16_t))

//方波
#define OUTPUT_SIGNAL2       square_wave
#define OUTPUT_SIGNAL_SIZE2  (sizeof(OUTPUT_SIGNAL2)/sizeof(uint16_t))

//锯齿波
#define OUTPUT_SIGNAL3       Sawtooth_Wave
#define OUTPUT_SIGNAL_SIZE3  (sizeof(OUTPUT_SIGNAL3)/sizeof(uint16_t))


int main(void)
{
//    uint8_t DAC_value;

    SYSCFG_DL_init();
    LED_GPIO_init();
    KEY_GPIO_init();
    
    /*Set output voltage:
     * DAC value (12-bits) = DesiredOutputVoltage * 4095
     *                       ---------------------------
     *                           ReferenceVoltage
     */
//    //使能DAC中断
//    NVIC_EnableIRQ(DAC12_INT_IRQN);
    
    while(1)
    {
       
        //按键实现不同波形输出
        key=keyscan(0);
        if(key & KEY_Value)
        {
            Mode++;
            temp = Mode;
            gCounter = 0;
            Delay_ms(1);
        }
         switch(temp % 4) {
            case 0:
                DL_DAC12_output12(DAC0, OUTPUT_SIGNAL0[gCounter++]);
                if(gCounter >= OUTPUT_SIGNAL_SIZE0) {
                    gCounter = 0;
                }
                break;
                
            case 1:
                DL_DAC12_output12(DAC0, OUTPUT_SIGNAL1[gCounter++]);
                if(gCounter >= OUTPUT_SIGNAL_SIZE1) {
                    gCounter = 0;
                }
                break;
                
            case 2:
                DL_DAC12_output12(DAC0, OUTPUT_SIGNAL2[gCounter++]);
                if(gCounter >= OUTPUT_SIGNAL_SIZE2) {
                    gCounter = 0;
                }
                break;
                
            case 3:
                DL_DAC12_output12(DAC0, OUTPUT_SIGNAL3[gCounter++]);
                if(gCounter >= OUTPUT_SIGNAL_SIZE3) {
                    gCounter = 0;
                }
                break;
        }
    }
}

//void DAC12_IRQHandler(void)
//{
//    switch(DL_DAC12_getPendingInterrupt(DAC0))
//    {
//        case DL_DAC12_IIDX_FIFO_1_2_EMPTY:

//            break;
//        default:
//            break;
//    }
//}
