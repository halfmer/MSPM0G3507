/**
 * @cliArgs --board "/ti/boards/LP_MSPM0G3507" --product "mspm0_sdk@2.05.01.00"
 * @versions {"tool":"1.24.1+4189"}
 */

/**
 * Import the modules used in this configuration.
 */
const GPIO   = scripting.addModule("/ti/driverlib/GPIO", {}, false);
const GPIO1  = GPIO.addInstance();
const SYSCTL = scripting.addModule("/ti/driverlib/SYSCTL");

/**
 * Write custom configuration values to the imported modules.
 */
GPIO1.$name                                 = "GPIO_SWITCH";
GPIO1.associatedPins.create(2);
GPIO1.associatedPins[0].direction           = "INPUT";
GPIO1.associatedPins[0].assignedPort        = "PORTB";
GPIO1.associatedPins[0].assignedPin         = "21";
GPIO1.associatedPins[0].interruptEn         = true;
GPIO1.associatedPins[0].interruptPriority   = "0";
GPIO1.associatedPins[0].polarity            = "RISE";
GPIO1.associatedPins[0].internalResistor    = "PULL_UP";
GPIO1.associatedPins[0].assignedPortSegment = "Upper";
GPIO1.associatedPins[0].$name               = "PIN_KEY";
GPIO1.associatedPins[1].initialValue        = "SET";
GPIO1.associatedPins[1].assignedPort        = "PORTB";
GPIO1.associatedPins[1].assignedPin         = "14";
GPIO1.associatedPins[1].$name               = "PIN_LED";

const Board = scripting.addModule("/ti/driverlib/Board", {}, false);

SYSCTL.clockTreeEn = true;

/**
 * Pinmux solution for unlocked pins/peripherals. This ensures that minor changes to the automatic solver in a future
 * version of the tool will not impact the pinmux you originally saw.  These lines can be completely deleted in order to
 * re-solve from scratch.
 */
GPIO1.associatedPins[0].pin.$suggestSolution = "j19_expansion.4";
GPIO1.associatedPins[1].pin.$suggestSolution = "j21_expansion.3";
Board.peripheral.$suggestSolution            = "DEBUGSS";
Board.peripheral.swclkPin.$suggestSolution   = "j25_expansion.16";
Board.peripheral.swdioPin.$suggestSolution   = "j25_expansion.14";
