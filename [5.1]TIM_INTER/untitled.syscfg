/**
 * @cliArgs --board "/ti/boards/LP_MSPM0G3507" --product "mspm0_sdk@2.05.01.00"
 * @versions {"tool":"1.24.1+4189"}
 */

/**
 * Import the modules used in this configuration.
 */
const GPIO   = scripting.addModule("/ti/driverlib/GPIO", {}, false);
const GPIO1  = GPIO.addInstance();
const SYSCTL = scripting.addModule("/ti/driverlib/SYSCTL");
const TIMER  = scripting.addModule("/ti/driverlib/TIMER", {}, false);
const TIMER1 = TIMER.addInstance();

/**
 * Write custom configuration values to the imported modules.
 */
GPIO1.portSegment                         = "Upper";
GPIO1.$name                               = "GPIO_LED";
GPIO1.associatedPins[0].direction         = "INPUT";
GPIO1.associatedPins[0].assignedPort      = "PORTB";
GPIO1.associatedPins[0].assignedPin       = "21";
GPIO1.associatedPins[0].interruptEn       = true;
GPIO1.associatedPins[0].interruptPriority = "0";
GPIO1.associatedPins[0].polarity          = "RISE";
GPIO1.associatedPins[0].$name             = "PIN_B";
GPIO1.associatedPins[0].internalResistor  = "PULL_UP";

const Board = scripting.addModule("/ti/driverlib/Board", {}, false);

SYSCTL.clockTreeEn = true;

TIMER1.$name               = "TIMER_0";
TIMER1.timerMode           = "PERIODIC_UP";
TIMER1.timerPeriod         = "1.00 ms";
TIMER1.timerStartTimer     = true;
TIMER1.retentionRestoreCnt = true;
TIMER1.interrupts          = ["LOAD"];

/**
 * Pinmux solution for unlocked pins/peripherals. This ensures that minor changes to the automatic solver in a future
 * version of the tool will not impact the pinmux you originally saw.  These lines can be completely deleted in order to
 * re-solve from scratch.
 */
GPIO1.associatedPins[0].pin.$suggestSolution = "j19_expansion.4";
Board.peripheral.$suggestSolution            = "DEBUGSS";
Board.peripheral.swclkPin.$suggestSolution   = "j25_expansion.16";
Board.peripheral.swdioPin.$suggestSolution   = "j25_expansion.14";
TIMER1.peripheral.$suggestSolution           = "TIMA0";
